## Kconfig
```kconfig
config ZMK_INPUT_PROCESSOR_TRACKBALL_THRESHOLD
    bool "Trackball threshold input processor"
    default y
    help
      Enable trackball movement threshold filtering input processor.
      This processor filters out small trackball movements below a configurable threshold,
      preventing accidental auto mouse layer activation from minor vibrations.

config ZMK_INPUT_PROCESSOR_TRACKBALL_THRESHOLD_DEFAULT_THRESHOLD
    int "Default movement threshold"
    default 5
    range 0 1000
    depends on ZMK_INPUT_PROCESSOR_TRACKBALL_THRESHOLD
    help
      Default threshold value for trackball movement filtering.
      Movement is calculated as abs(x) + abs(y).
      Values below this threshold will be discarded. 
```

## dts/bindings/zmk,input-processor-trackball-threshold.yaml
```yaml
description: |
  Trackball threshold input processor that filters out small movements below a configurable threshold.
  This helps prevent accidental auto mouse layer activation from minor trackball vibrations.

compatible: "zmk,input-processor-trackball-threshold"

properties:
  movement-threshold:
    type: int
    default: 5
    description: |
      Minimum movement threshold for trackball input.
      Movement is calculated as abs(x) + abs(y).
      Values below this threshold will be discarded.

  track-remainders:
    type: boolean
    default: false
    description: |
      Whether to track remainder values for precise input processing.
      This is required by the ZMK input processor system.

input-processor-cells: []
```

## test/config/west.yml
```yaml
manifest:
  remotes:
    - name: zmkfirmware
      url-base: https://github.com/zmkfirmware
    - name: local
      url-base: file://
  projects:
    - name: zmk
      remote: zmkfirmware
      revision: main
      import: app/west.yml
    # Local module for testing
    - name: zmk-trackball-threshold
      remote: local
      path: /Users/yamaryu211/Dev/zmk/roBa/zmk-modules/zmk-trackball-threshold
  self:
    path: config
```
